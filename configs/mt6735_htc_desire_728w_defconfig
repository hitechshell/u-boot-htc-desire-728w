## configs/mt6735_htc_desire_728w_defconfig
```kconfig
CONFIG_ARM=y
CONFIG_COUNTER_FREQUENCY=13000000
CONFIG_ARCH_MEDIATEK=y
CONFIG_TEXT_BASE=0x40080000
CONFIG_SYS_MALLOC_F_LEN=0x4000
CONFIG_POSITION_INDEPENDENT=y

CONFIG_BAUDRATE=921600

CONFIG_SPL_GPIO=y
CONFIG_NR_DRAM_BANKS=1
CONFIG_SPL_LDSCRIPT="arch/arm/armv8/cpu/u-boot-spl.lds"
CONFIG_ENV_SIZE=0x1000
CONFIG_DM_GPIO=y
CONFIG_DEFAULT_DEVICE_TREE="mt6735-htc-desire-728w"
CONFIG_SPL_TEXT_BASE=0x201000
CONFIG_DM_RESET=y
CONFIG_SPL_MMC=y
CONFIG_SPL_SERIAL=y
CONFIG_SPL_STACK_R_ADDR=0x40800000
CONFIG_SPL_BSS_MAX_SIZE=0x40000
CONFIG_SPL_STACK_R=y
CONFIG_SPL_SIZE_LIMIT=0x40000
CONFIG_DEBUG_UART_BASE=0x11002000
CONFIG_DEBUG_UART_CLOCK=26000000
CONFIG_SPL_FS_FAT=y
CONFIG_ARMV8_PSCI=y
CONFIG_SYS_LOAD_ADDR=0x42007f1c
CONFIG_SPL_PAYLOAD="u-boot.img"
CONFIG_BUILD_TARGET="u-boot-mtk.bin"
CONFIG_DEBUG_UART=y
CONFIG_SPL_IMAGE="spl/u-boot-spl-mtk.bin"
CONFIG_FIT=y
CONFIG_FIT_VERBOSE=y
CONFIG_SPL_FIT_PRINT=y
CONFIG_SPL_LOAD_FIT=y
CONFIG_SPL_LOAD_FIT_ADDRESS=0x41000000
CONFIG_SPL_LOAD_FIT_APPLY_OVERLAY=y
CONFIG_SPL_BOOTSTD=y
CONFIG_BOOTSTD_FULL=y
# CONFIG_BOOTMETH_VBE is not set
CONFIG_SD_BOOT=y
CONFIG_SD_BOOT_QSPI=y
CONFIG_BOOTDELAY=3
# CONFIG_USE_BOOTCOMMAND is not set
CONFIG_DEFAULT_FDT_FILE="mt6735-htc-desire-728w"
CONFIG_LOGLEVEL=6
CONFIG_SYS_CONSOLE_IS_IN_ENV=y
CONFIG_SYS_STDIO_DEREGISTER=y
CONFIG_SPL_LOG=y
CONFIG_SPL_LOG_MAX_LEVEL=6
CONFIG_LOG_ERROR_RETURN=y
CONFIG_SPL_MAX_SIZE=0x40000
CONFIG_SPL_LEGACY_IMAGE_FORMAT=y
CONFIG_SPL_SYS_MALLOC_SIMPLE=y
CONFIG_SYS_MMCSD_RAW_MODE_U_BOOT_USE_SECTOR=y
CONFIG_SYS_MMCSD_RAW_MODE_U_BOOT_SECTOR=0x40000
CONFIG_SPL_FS_EXT4=y
CONFIG_SPL_FS_SQUASHFS=y
CONFIG_SPL_FAT_WRITE=y
CONFIG_SPL_MMC_WRITE=y
CONFIG_SPL_POWER_DOMAIN=y
CONFIG_SPL_WATCHDOG=y
CONFIG_SPL_ATF=y
CONFIG_SYS_PROMPT="U-Boot> "
CONFIG_CMD_BOOTMENU=y
CONFIG_CMD_GPIO=y
CONFIG_CMD_LOADM=y
CONFIG_CMD_MMC=y
CONFIG_CMD_BKOPS_ENABLE=y
CONFIG_CMD_MMC_REG=y
CONFIG_CMD_MMC_SWRITE=y
CONFIG_CMD_READ=y
CONFIG_CMD_SDRAM=y
CONFIG_CMD_USB_MASS_STORAGE=y
CONFIG_CMD_UMS_ABORT_KEYED=y
CONFIG_CMD_WDT=y
CONFIG_CMD_WRITE=y
CONFIG_CMD_LOG=y
# CONFIG_ISO_PARTITION is not set
# CONFIG_EFI_PARTITION is not set
CONFIG_OF_SPL_REMOVE_PROPS=""
CONFIG_SYS_RELOC_GD_ENV_ADDR=y
# CONFIG_NET is not set
CONFIG_SPL_DM_SEQ_ALIAS=y
CONFIG_SPL_REGMAP=y
CONFIG_SPL_SYSCON=y
CONFIG_CLK=y
CONFIG_SPL_CLK=y
# CONFIG_I2C is not set
CONFIG_DM_KEYBOARD=y
CONFIG_MMC_IO_VOLTAGE=y
CONFIG_MMC_UHS_SUPPORT=y
CONFIG_MMC_HS400_ES_SUPPORT=y
CONFIG_MMC_HS400_SUPPORT=y
CONFIG_MMC_MTK=y
CONFIG_PHY=y
CONFIG_PHY_MTK_TPHY=y
CONFIG_PINCTRL=y
CONFIG_PINCONF=y
CONFIG_SPL_PINCTRL=y
CONFIG_SPL_PINCONF=y
CONFIG_PINCTRL_MT6735=y
CONFIG_POWER_DOMAIN=y
CONFIG_MTK_POWER_DOMAIN=y
CONFIG_DM_PMIC=y
CONFIG_PMIC_MT6328=y
CONFIG_DM_REGULATOR=y
CONFIG_SPL_DM_REGULATOR=y
CONFIG_DM_REGULATOR_MT6328=y
CONFIG_XPL_DM_REGULATOR_MT6328=y
CONFIG_DM_REGULATOR_FIXED=y
CONFIG_SPL_DM_REGULATOR_FIXED=y
CONFIG_DM_REGULATOR_GPIO=y
CONFIG_SPL_DM_REGULATOR_GPIO=y
CONFIG_PWRAP=y
CONFIG_MT6735_PWRAP=y
#CONFIG_RAM=y
#CONFIG_SPL_RAM=y
CONFIG_DM_SERIAL=y
CONFIG_MTK_SERIAL=y
CONFIG_SYSRESET=y
CONFIG_SYSRESET_WATCHDOG=y

# USB stuff

#CONFIG_USB=y
# CONFIG_SPL_DM_USB is not set
#CONFIG_DM_USB_GADGET=y
#CONFIG_USB_MUSB_GADGET=y
#CONFIG_USB_MUSB_MTK=y
#CONFIG_USB_MUSB_PIO_ONLY=y
#CONFIG_USB_GADGET=y
#CONFIG_USB_GADGET_DOWNLOAD=y

CONFIG_WDT_MTK=y
CONFIG_SPL_LZMA=y

CONFIG_INIT_SP_RELATIVE=y

CONFIG_BUTTON=y
CONFIG_BUTTON_GPIO=y

# Simple Framebuffer
CONFIG_VIDEO=y
CONFIG_VIDEO_SIMPLE=y
CONFIG_CONSOLE_MUX=y

# Filesystems
CONFIG_EFI_PARTITION=y
```
